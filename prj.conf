## CMakeLists.txt
```
# SPDX-License-Identifier: Apache-2.0

cmake_minimum_required(VERSION 3.13.1)
set(QEMU_EXTRA_FLAGS -s)

include($ENV{ZEPHYR_BASE}/cmake/app/boilerplate.cmake NO_POLICY_SCOPE)
project(mesh)

target_sources(app PRIVATE src/main.c)
target_sources(app PRIVATE src/board.c)
```

## prj.conf
```kconfig
#CONFIG_INIT_STACKS=y
CONFIG_MAIN_STACK_SIZE=512
CONFIG_SYSTEM_WORKQUEUE_STACK_SIZE=2048

CONFIG_BT_SETTINGS=y
CONFIG_FLASH=y
CONFIG_FLASH_PAGE_LAYOUT=y
CONFIG_FLASH_MAP=y
CONFIG_FCB=y
CONFIG_SETTINGS=y
CONFIG_SETTINGS_FCB=y

CONFIG_BT_OBSERVER=y
CONFIG_BT_BROADCASTER=y
CONFIG_BT_DATA_LEN_UPDATE=n

CONFIG_BT_PERIPHERAL=y

CONFIG_BT=y
CONFIG_BT_TINYCRYPT_ECC=y
CONFIG_BT_L2CAP_TX_MTU=69
CONFIG_BT_L2CAP_TX_BUF_COUNT=5

CONFIG_BT_MESH=y
CONFIG_BT_MESH_RELAY=y
CONFIG_BT_MESH_LOW_POWER=n
CONFIG_BT_MESH_FRIEND=y
CONFIG_BT_MESH_FRIEND_QUEUE_SIZE=16

CONFIG_BT_MESH_PB_GATT=y
CONFIG_BT_MESH_PB_ADV=y
CONFIG_BT_MESH_GATT_PROXY=y

#CONFIG_BT_MESH_LPN_SCAN_LATENCY=30
#CONFIG_BT_MESH_LPN_RECV_DELAY=40
#CONFIG_BT_MESH_LPN_POLL_TIMEOUT=300

CONFIG_BT_MESH_SUBNET_COUNT=2
CONFIG_BT_MESH_APP_KEY_COUNT=2
CONFIG_BT_MESH_MODEL_GROUP_COUNT=2
CONFIG_BT_MESH_LABEL_COUNT=3

#CONFIG_BT_MESH_IV_UPDATE_TEST=y

#CONFIG_UART_CONSOLE=n
#CONFIG_BT_DEBUG_MONITOR=y
CONFIG_BT_DEBUG_LOG=y

CONFIG_BT_MESH_DEBUG=y
#CONFIG_BT_MESH_DEBUG_PROV=y
#CONFIG_BT_MESH_DEBUG_PROXY=y
#CONFIG_BT_MESH_DEBUG_BEACON=y
CONFIG_BT_MESH_DEBUG_NET=y
CONFIG_BT_MESH_DEBUG_TRANS=y
CONFIG_BT_MESH_DEBUG_SETTINGS=y
#CONFIG_BT_MESH_DEBUG_LOW_POWER=y
CONFIG_BT_MESH_DEBUG_FRIEND=y
#CONFIG_BT_MESH_DEBUG_MODEL=y
#CONFIG_BT_MESH_DEBUG_ACCESS=y
#CONFIG_BT_MESH_DEBUG_CRYPTO=y
#CONFIG_BT_MESH_DEBUG_ADV=y
#CONFIG_BT_MESH_SELF_TEST=y
```

## nrf52840dk_nrf52840.overlay
```dts
&uart0 {
	compatible = "nordic,nrf-uart";
	current-speed = <921600>;
	status = "ok";
	tx-pin = <6>;
	rx-pin = <8>;
	rts-pin = <5>;
	cts-pin = <7>;
};
```

## src/main.c
```c
/* main.c - Application main entry point */

/*
 * Copyright (c) 2017 Intel Corporation
 *
 * SPDX-License-Identifier: Apache-2.0
 */

#include <sys/printk.h>
#include <sys/byteorder.h>
#include <logging/log.h>
#include <settings/settings.h>

#include <bluetooth/bluetooth.h>
#include <bluetooth/mesh.h>
#include <bluetooth/conn.h>

typedef enum {
    LED_STATE_ON,
    LED_STATE_OFF
} led_state_t;

static led_state_t led0_state = LED_STATE_OFF;

LOG_MODULE_REGISTER(main);

static struct bt_mesh_health_srv health_srv = {
};

BT_MESH_HEALTH_PUB_DEFINE(health_pub, 0);

static struct bt_mesh_model_pub gen_onoff_pub;

static void gen_onoff_get(struct bt_mesh_model *model,
			  struct bt_mesh_msg_ctx *ctx,
			  struct net_buf_simple *buf)
{
	NET_BUF_SIMPLE_DEFINE(msg, 2 + 1 + 4);

	LOG_INF("addr 0x%04x current state %s", bt_mesh_model_elem(model)->addr, (LED_STATE_ON == led0_state) ? "on" : "off");

	bt_mesh_model_msg_init(&msg, BT_MESH_MODEL_OP_2(0x82, 0x04));
	net_buf_simple_add_u8(&msg, (LED_STATE_ON == led0_state) ? 0x01 : 0x00);
	bt_mesh_model_send(model, ctx, &msg, NULL, NULL);
}

static void gen_onoff_set_unack(struct bt_mesh_model *model,
				struct bt_mesh_msg_ctx *ctx,
				struct net_buf_simple *buf)
{
	struct net_buf_simple *msg;

	if (0x01 == net_buf_simple_pull_u8(buf)) {
		LOG_INF("addr 0x%04x set to on", bt_mesh_model_elem(model)->addr);
		led0_state = LED_STATE_ON;
	} else {
		LOG_INF("addr 0x%04x set to off", bt_mesh_model_elem(model)->addr);
		led0_state = LED_STATE_OFF;
	}

	/*
	 * If a server has a publish address, it is required to
	 * publish status on a state change
	 *
	 * See Mesh Profile Specification 3.7.6.1.2
	 *
	 * Only publish if there is an assigned address
	 */
	if (BT_MESH_ADDR_UNASSIGNED != model->pub->addr) {
		msg = model->pub->msg;
		bt_mesh_model_msg_init(msg, BT_MESH_MODEL_OP_2(0x82, 0x04));
		net_buf_simple_add_u8(msg, (LED_STATE_ON == led0_state) ? 0x01 : 0x00);
		bt_mesh_model_publish(model);
	}
}

static void gen_onoff_set(struct bt_mesh_model *model,
			  struct bt_mesh_msg_ctx *ctx,
			  struct net_buf_simple *buf)
{
	gen_onoff_set_unack(model, ctx, buf);
	gen_onoff_get(model, ctx, buf);
}

static void connected(struct bt_conn *conn, uint8_t err)
{
	char addr[BT_ADDR_LE_STR_LEN];

	if (err) {
		LOG_ERR("Connection failed (err %u)", err);
		return;
	}

	bt_addr_le_to_str(bt_conn_get_dst(conn), addr, sizeof(addr));
	LOG_INF("Connect index %u, address %s", bt_conn_index(conn), log_strdup(addr));
}

static void disconnected(struct bt_conn *conn, uint8_t reason)
{
	LOG_INF("Disconnect index %u (reason %u)", bt_conn_index(conn), reason);
}

static struct bt_conn_cb conn_callbacks = {
	.connected = connected,
	.disconnected = disconnected,
};

static const struct bt_mesh_model_op gen_onoff_op[] = {
	{ BT_MESH_MODEL_OP_2(0x82, 0x01), 0, gen_onoff_get },
	{ BT_MESH_MODEL_OP_2(0x82, 0x02), 2, gen_onoff_set },
	{ BT_MESH_MODEL_OP_2(0x82, 0x03), 2, gen_onoff_set_unack },
	BT_MESH_MODEL_OP_END,
};

static struct bt_mesh_model root_models[] = {
	BT_MESH_MODEL_CFG_SRV,
	BT_MESH_MODEL_HEALTH_SRV(&health_srv, &health_pub),
	BT_MESH_MODEL(BT_MESH_MODEL_ID_GEN_ONOFF_SRV, gen_onoff_op, &gen_onoff_pub, NULL),
};

static struct bt_mesh_elem elements[] = {
	BT_MESH_ELEM(0, root_models, BT_MESH_MODEL_NONE),
};

static const struct bt_mesh_comp comp = {
	.cid = BT_COMP_ID_LF,
	.elem = elements,
	.elem_count = ARRAY_SIZE(elements),
};

static int output_number(bt_mesh_output_action_t action, uint32_t number)
{
	LOG_INF("OOB Number: %u", number);

	return 0;
}

static void prov_complete(uint16_t net_idx, uint16_t addr)
{
	LOG_INF("Provisionee Index: %u", net_idx);
}

static void prov_reset(void)
{
	bt_mesh_prov_enable(BT_MESH_PROV_ADV | BT_MESH_PROV_GATT);
}

static const uint8_t dev_uuid[16] = { 0xdd, 0xdd };

static const struct bt_mesh_prov prov = {
	.uuid = dev_uuid,
	.output_size = 4,
	.output_actions = BT_MESH_DISPLAY_NUMBER,
	.output_number = output_number,
	.complete = prov_complete,
	.reset = prov_reset,
};

static void bt_ready(int err)
{
	if (err) {
		LOG_ERR("Bluetooth init failed (err %d)", err);
		return;
	}

	LOG_INF("Bluetooth initialized");

	err = bt_mesh_init(&prov, &comp);
	if (err) {
		LOG_ERR("Initializing mesh failed (err %d)", err);
		return;
	}

	if (IS_ENABLED(CONFIG_SETTINGS)) {
		settings_load();
	}

	/* This will be a no-op if settings_load() loaded provisioning info */
	bt_mesh_prov_enable(BT_MESH_PROV_ADV | BT_MESH_PROV_GATT);

	LOG_INF("Mesh initialized");
}

void main(void)
{
	int err;

	LOG_INF("Initializing ...");

	/* Initialize the Bluetooth Subsystem */
	err = bt_enable(bt_ready);
	if (err) {
		LOG_ERR("Bluetooth init failed (err %d)", err);
	}

	bt_conn_cb_register(&conn_callbacks);

	while (1) {
		k_msleep(700);
	}
}
```

## src/board.c
```c
#include <zephyr.h>
#include <device.h>
#include <devicetree.h>
#include <drivers/gpio.h>
#include <logging/log.h>

#include "board.h"

LOG_MODULE_REGISTER(board);

#define LED_INDICATOR_NODE      DT_ALIAS(led0)
#define LED_INDICATOR_PIN		DT_GPIO_PIN(LED_INDICATOR_NODE, gpios)
#define LED_INDICATOR_PORT		DT_GPIO_LABEL(LED_INDICATOR_NODE, gpios)
#define LED_INDICATOR_FLAG      DT_GPIO_FLAGS(LED_INDICATOR_NODE, gpios)

#define LED_BULB_NODE           DT_ALIAS(led1)
#define LED_BULB_PIN			DT_GPIO_PIN(LED_BULB_NODE, gpios)
#define LED_BULB_PORT			DT_GPIO_LABEL(LED_BULB_NODE, gpios)
#define LED_BULB_FLAG           DT_GPIO_FLAGS(LED_BULB_NODE, gpios)

void board_init(void)
{
	int err;
    const struct device *dev;

	/* Set LED indicator pin as output */
	dev = device_get_binding(LED_INDICATOR_PORT);
	if (NULL == dev) {
		LOG_ERR("Failed to get binding %s", LED_INDICATOR_PORT);
		return;
	}
	err = gpio_pin_configure(dev, LED_INDICATOR_PIN, LED_INDICATOR_FLAG | GPIO_OUTPUT_LOW | GPIO_INPUT);
	if (err) {
		LOG_ERR("Failed to configure pin %s (err %d)", LED_INDICATOR_PORT, err);
		return;
	}

	/* Set LED bulb pin as output */
	dev = device_get_binding(LED_BULB_PORT);
	if (NULL == dev) {
		LOG_ERR("Failed to get binding %s", LED_BULB_PORT);
		return;
	}
	err = gpio_pin_configure(dev, LED_BULB_PIN, LED_BULB_FLAG | GPIO_OUTPUT_LOW | GPIO_INPUT);
	if (err) {
		LOG_ERR("Failed to configure pin %s (err %d)", LED_BULB_PORT, err);
		return;
	}
}

void board_led_set(led_alias_t led, led_state_t new_state)
{
	int err;
	const struct device *dev;
	const char * name;
	gpio_pin_t pin;

	switch (led) {
		case LED_ALIAS_INDICATOR:
			name = LED_INDICATOR_PORT;
			pin = LED_INDICATOR_PIN;
			break;
		case LED_ALIAS_BULB:
			name = LED_BULB_PORT;
			pin = LED_BULB_PIN;
			break;
		default:
			LOG_WRN("Unknown LED: %u", led);
			return;
	}

	dev = device_get_binding(name);
	if (NULL == dev) {
		LOG_ERR("Failed to get binding %s", name);
		return;
	}
	err = gpio_pin_set(dev, pin, (LED_STATE_ON == new_state) ? 1 : 0);
	if (err) {
		LOG_ERR("Failed to set pin %s (err %d)", name, err);
		return;
	}
}

led_state_t board_led_get(led_alias_t led)
{
	int err;
	const struct device *dev;
	const char * name;
	gpio_pin_t pin;

	switch (led) {
		case LED_ALIAS_INDICATOR:
			name = LED_INDICATOR_PORT;
			pin = LED_INDICATOR_PIN;
			break;
		case LED_ALIAS_BULB:
			name = LED_BULB_PORT;
			pin = LED_BULB_PIN;
			break;
		default:
			LOG_WRN("Unknown LED: %u", led);
			return LED_STATE_OFF;
	}

	dev = device_get_binding(name);
	if (NULL == dev) {
		LOG_ERR("Failed to get binding %s", name);
		return LED_STATE_OFF;
	}
	err = gpio_pin_get(dev, pin);
	if (err < 0) {
		LOG_ERR("Failed to get pin %s (err %d)", name, err);
		return LED_STATE_OFF;
	}

	return (1 == err) ? LED_STATE_ON : LED_STATE_OFF;
}

void board_led_trigger(led_alias_t led)
{
	led_state_t old_state;

	old_state = board_led_get(led);
	switch (old_state) {
		case LED_STATE_ON:
			LOG_DBG("Old state is ON");
			board_led_set(led, LED_STATE_OFF);
			break;
		case LED_STATE_OFF:
			LOG_DBG("Old state is OFF");
			board_led_set(led, LED_STATE_ON);
			break;
		default:
			LOG_WRN("Unknown state: %u", old_state);
			return;
	}
}
```

## src/board.h
```c
/* board.h - Board-specific hooks */

typedef enum {
    LED_ALIAS_INDICATOR,
    LED_ALIAS_BULB
} led_alias_t;

typedef enum {
    LED_STATE_ON,
    LED_STATE_OFF
} led_state_t;

void board_init(void);
void board_led_set(led_alias_t led, led_state_t new_state);
led_state_t board_led_get(led_alias_t led);
void board_led_trigger(led_alias_t led);
```
